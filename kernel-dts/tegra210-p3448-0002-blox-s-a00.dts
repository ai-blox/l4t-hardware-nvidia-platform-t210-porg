/*
 * arch/arm64/boot/dts/tegra210-p3448-0000-p3449-0000-b00.dts
 *
 * Copyright (c) 2018-2019, NVIDIA CORPORATION.  All rights reserved.
 *
 * This program is free software; you can redistribute it and/or modify
 * it under the terms of the GNU General Public License as published by
 * the Free Software Foundation; version 2 of the License.
 *
 * This program is distributed in the hope that it will be useful, but WITHOUT
 * ANY WARRANTY; without even the implied warranty of MERCHANTABILITY or
 * FITNESS FOR A PARTICULAR PURPOSE.  See the GNU General Public License for
 * more details.
 *
 * You should have received a copy of the GNU General Public License along
 * with this program; if not, write to the Free Software Foundation, Inc.,
 * 51 Franklin Street, Fifth Floor, Boston, MA  02110-1301, USA.
 *
 */

#include "tegra210-porg-p3448-blox-s-common.dtsi"
#include "porg-platforms/tegra210-porg-pinmux-aibp0020pb.dtsi"
#include "porg-platforms/tegra210-porg-gpio-aibp0020pb.dtsi"
#include "porg-platforms/tegra210-porg-p3448-emc-a00.dtsi"

/ {
	model = "ai-blox, BLOX-S [10.10.0004]";
	compatible = "nvidia,p3449-0000-b00+p3448-0002-b00", "nvidia,jetson-nano", "nvidia,tegra210";
	nvidia,dtsfilename = __FILE__;
	aiblox,hdmi = "0x25";

	sdhci@700b0600 { /* SDMMC4 for EMMC */
		status = "okay";
	};

	sdhci@700b0000 { /* SDMMC1 for SD card */
		status = "disabled";
	};

	spi@70410000 { /* QSPI */
		status = "disabled";
	};

};